## buildroot-hearth/configs/hearth_pi5_defconfig
```kconfig
# Hearth Pi 5 defconfig
# Based on Buildroot's official raspberrypi5_defconfig with additions for
# NetworkManager, GStreamer, systemd, and Hearth services.
#
# flutter-pi and the Flutter engine are NOT built by Buildroot. They are
# provided as pre-built binaries in the rootfs overlay, cross-compiled by
# flutterpi_tool in CI. This decouples the Flutter version from Buildroot
# and lets us use the latest Flutter without waiting for Buildroot updates.

# === Base: raspberrypi5_defconfig ===
BR2_aarch64=y
BR2_cortex_a76=y
BR2_TOOLCHAIN_BUILDROOT_CXX=y
BR2_GLOBAL_PATCH_DIR="board/raspberrypi/patches"
BR2_DOWNLOAD_FORCE_CHECK_HASHES=y
BR2_LINUX_KERNEL=y
BR2_LINUX_KERNEL_CUSTOM_TARBALL=y
BR2_LINUX_KERNEL_CUSTOM_TARBALL_LOCATION="$(call github,raspberrypi,linux,576cc10e1ed50a9eacffc7a05c796051d7343ea4)/linux-576cc10e1ed50a9eacffc7a05c796051d7343ea4.tar.gz"
BR2_LINUX_KERNEL_DEFCONFIG="bcm2712"
BR2_LINUX_KERNEL_DTS_SUPPORT=y
BR2_LINUX_KERNEL_INTREE_DTS_NAME="broadcom/bcm2712-rpi-5-b broadcom/bcm2712d0-rpi-5-b"
BR2_LINUX_KERNEL_NEEDS_HOST_OPENSSL=y
BR2_PACKAGE_BUSYBOX_SHOW_OTHERS=y
BR2_PACKAGE_RPI_FIRMWARE=y
# config.txt is written by our post_build.sh
BR2_PACKAGE_RPI_FIRMWARE_INSTALL_DTB_OVERLAYS=y
BR2_PACKAGE_RPI_FIRMWARE_CMDLINE_FILE="board/raspberrypi5/cmdline_5.txt"
BR2_PACKAGE_XZ=y
BR2_PACKAGE_KMOD=y
BR2_PACKAGE_KMOD_TOOLS=y
BR2_PACKAGE_HOST_KMOD_XZ=y
BR2_TARGET_ROOTFS_EXT2=y
BR2_TARGET_ROOTFS_EXT2_4=y
# BR2_TARGET_ROOTFS_TAR is not set
BR2_PACKAGE_HOST_DOSFSTOOLS=y
BR2_PACKAGE_HOST_GENIMAGE=y
BR2_PACKAGE_HOST_MTOOLS=y

# === Hearth additions ===

# Toolchain: glibc required by flutter-pi/engine at runtime
BR2_TOOLCHAIN_BUILDROOT_GLIBC=y
BR2_USE_WCHAR=y
BR2_INSTALL_LIBSTDCPP=y
BR2_PACKAGE_HOST_LINUX_HEADERS_CUSTOM_6_6=y

# Kernel: add USB audio, touchscreen, and WiFi driver fragments
BR2_LINUX_KERNEL_CONFIG_FRAGMENT_FILES="board/raspberrypi/linux-4k-page-size.fragment $(BR2_EXTERNAL_HEARTH_PATH)/board/hearth-pi5/linux.fragment"

# Rootfs: sized for app bundle + GStreamer + system
BR2_TARGET_ROOTFS_EXT2_SIZE="512M"

# Init system: systemd (required by flutter-pi and NetworkManager)
BR2_INIT_SYSTEMD=y
BR2_PACKAGE_SYSTEMD_LOGIND=y

# Set root password
BR2_TARGET_GENERIC_ROOT_PASSWD="hearth"

# SSH (dropbear is lightweight, good for embedded)
BR2_PACKAGE_DROPBEAR=y
BR2_PACKAGE_DROPBEAR_CLIENT=y

# Network
BR2_PACKAGE_NETWORK_MANAGER=y
BR2_PACKAGE_AVAHI=y
BR2_PACKAGE_AVAHI_DAEMON=y

# Graphics / DRM (runtime deps for flutter-pi)
BR2_PACKAGE_MESA3D=y
BR2_PACKAGE_MESA3D_GALLIUM_DRIVER_V3D=y
BR2_PACKAGE_MESA3D_GALLIUM_DRIVER_VC4=y
BR2_PACKAGE_MESA3D_OPENGL_ES=y
BR2_PACKAGE_MESA3D_OPENGL_EGL=y
BR2_PACKAGE_MESA3D_VULKAN_DRIVER_BROADCOM=y
BR2_PACKAGE_VULKAN_LOADER=y
BR2_PACKAGE_LIBDRM=y
BR2_PACKAGE_LIBINPUT=y
BR2_PACKAGE_LIBXKBCOMMON=y

# GStreamer (runtime deps for flutter-pi audio/video)
BR2_PACKAGE_GSTREAMER1=y
BR2_PACKAGE_GST1_PLUGINS_BASE=y
BR2_PACKAGE_GST1_PLUGINS_BASE_PLUGIN_ALSA=y
BR2_PACKAGE_GST1_PLUGINS_BASE_PLUGIN_VIDEOCONVERTSCALE=y
BR2_PACKAGE_GST1_PLUGINS_GOOD=y
BR2_PACKAGE_GST1_PLUGINS_GOOD_PLUGIN_V4L2=y
BR2_PACKAGE_GST1_PLUGINS_BAD=y
BR2_PACKAGE_GST1_PLUGINS_BAD_PLUGIN_KMS=y

# Audio
BR2_PACKAGE_ALSA_LIB=y
BR2_PACKAGE_ALSA_UTILS=y

# Hearth OTA updater
BR2_PACKAGE_HEARTH_UPDATER=y

# Rootfs overlay and post-build scripts
BR2_ROOTFS_OVERLAY="$(BR2_EXTERNAL_HEARTH_PATH)/board/hearth-pi5/overlay"
BR2_ROOTFS_POST_BUILD_SCRIPT="board/raspberrypi5/post-build.sh $(BR2_EXTERNAL_HEARTH_PATH)/board/hearth-pi5/post_build.sh"
BR2_ROOTFS_POST_IMAGE_SCRIPT="board/raspberrypi5/post-image.sh"
```

## buildroot-hearth/package/flutter-pi/Config.in
```kconfig
config BR2_PACKAGE_FLUTTER_PI
	bool "flutter-pi"
	depends on BR2_PACKAGE_MESA3D
	depends on BR2_PACKAGE_LIBINPUT
	depends on BR2_PACKAGE_LIBDRM
	help
	  Flutter runtime for Raspberry Pi using DRM/KMS.
	  Renders Flutter apps directly on the framebuffer
	  without X11 or Wayland.

	  https://github.com/ardera/flutter-pi
```

## buildroot-hearth/package/hearth-updater/Config.in
```kconfig
config BR2_PACKAGE_HEARTH_UPDATER
	bool "hearth-updater"
	help
	  OTA app bundle updater for Hearth. Checks GitHub Releases
	  for new versions and atomically swaps the app bundle.
```
